## meta-localcustom/conf/layer.conf
```bitbake
# Minimal local layer for headless Wi-Fi customization on Raspberry Pi
BBPATH .= ":${LAYERDIR}"

BBFILES += "${LAYERDIR}/recipes*/*/*.bb \
            ${LAYERDIR}/recipes*/*/*.bbappend"

BBFILE_COLLECTIONS += "localcustom"
BBFILE_PATTERN_localcustom := "^${LAYERDIR}/"
BBFILE_PRIORITY_localcustom = "20"

LAYERSERIES_COMPAT_localcustom = "walnascar"
LAYERDEPENDS_localcustom = "core"
```
